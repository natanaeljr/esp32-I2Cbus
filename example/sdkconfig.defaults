## example/sdkconfig.defaults
```kconfig
#
# I2Cbus
#
CONFIG_I2CBUS_LOG_ERRORS=y
CONFIG_I2CBUS_LOG_READWRITES=
CONFIG_I2CBUS_LOG_RW_LEVEL_INFO=
CONFIG_I2CBUS_LOG_RW_LEVEL_DEBUG=
CONFIG_I2CBUS_LOG_RW_LEVEL_VERBOSE=
```
